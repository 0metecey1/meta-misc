## conf/layer.conf
```bitbake
# We have a conf and classes directory, add to BBPATH
BBPATH .= ":${LAYERDIR}"

# We have recipes-* directories, add to BBFILES
BBFILES += "${LAYERDIR}/recipes-*/*/*.bb ${LAYERDIR}/recipes-*/*/*.bbappend"

BBFILE_COLLECTIONS += "misc-layer"
BBFILE_PATTERN_misc-layer = "^${LAYERDIR}/"
BBFILE_PRIORITY_misc-layer = "92"
# BBFILE_COLLECTIONS += "/home/build/rocko/layers/meta-misc"
# BBFILE_PATTERN_/home/build/rocko/layers/meta-misc = "^${LAYERDIR}/"
# BBFILE_PRIORITY_/home/build/rocko/layers/meta-misc = "92"
```
